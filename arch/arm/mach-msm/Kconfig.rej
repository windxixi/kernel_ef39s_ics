## arch/arm/mach-msm/Kconfig.rej
```kconfig
--- arch/arm/mach-msm/Kconfig
+++ arch/arm/mach-msm/Kconfig
@@ -2104,8 +2104,10 @@
 
 choice
     prompt "SWIQI"
-    optional
-    default n
+    default SWIQI_NONE
+    config SWIQI_NONE
+    	bool "Disable SWIQI/2"
+
     config SEMC_SWIQI
         bool "Enable SWIQI"
         default n
```

## drivers/cpufreq/Kconfig.rej
```kconfig
--- drivers/cpufreq/Kconfig
+++ drivers/cpufreq/Kconfig
@@ -194,6 +201,14 @@
 	  'smartassV2' - a "smart" governor
 	  If in doubt, say N.
 
+config CPU_FREQ_GOV_LULZACTIVE
+	tristate "'lulzactive' cpufreq governor"
+	depends on CPU_FREQ
+	help
+	  'lulzactive' - a new interactive governor by Tegrak!
+
+	  If in doubt, say N.
+
 config CPU_FREQ_GOV_INTERACTIVE
 	tristate "'interactive' cpufreq policy governor"
 	help
```
